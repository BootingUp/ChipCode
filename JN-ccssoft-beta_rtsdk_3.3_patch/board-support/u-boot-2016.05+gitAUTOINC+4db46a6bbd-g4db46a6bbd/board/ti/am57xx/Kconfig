## JN-ccssoft-beta_rtsdk_3.3_patch/board-support/u-boot-2016.05+gitAUTOINC+4db46a6bbd-g4db46a6bbd/board/ti/am57xx/Kconfig
```kconfig
if TARGET_AM57XX_EVM

config SYS_BOARD
	default "am57xx"

config SYS_VENDOR
	default "ti"

config SYS_CONFIG_NAME
	default "am57xx_evm"

config CONS_INDEX
        int "UART used for console"
        range 1 6
        default 3
        help
          The AM57x (and DRA7xx) SoC has a total of 6 UARTs available to it.
          Depending on your specific board you may want something other than UART3
          here.

choice
    prompt "JN board name select"
    optional

config JN_MINI5728
    bool "JN-mini5728"

config JN_SG300
    bool "JN-SG300"

config JN_MINIVB
    bool "JN-miniVB"

config JN_CCSSOFT_BETA
	bool "JN-ccssoft-beta"

config JN_PAL5728
    bool "JN-pal5728"

endchoice

source "board/ti/common/Kconfig"

endif
```
